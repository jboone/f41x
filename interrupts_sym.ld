/* Interrupts */
PROVIDE(_wwdg = _default_exception_handler);
PROVIDE(_pvd = _default_exception_handler);
PROVIDE(_tamp_stamp = _default_exception_handler);
PROVIDE(_rtc_wkup = _default_exception_handler);
PROVIDE(_flash = _default_exception_handler);
PROVIDE(_rcc = _default_exception_handler);
PROVIDE(_exti0 = _default_exception_handler);
PROVIDE(_exti1 = _default_exception_handler);
PROVIDE(_exti2 = _default_exception_handler);
PROVIDE(_exti3 = _default_exception_handler);
PROVIDE(_exti4 = _default_exception_handler);
PROVIDE(_dma1_stream0 = _default_exception_handler);
PROVIDE(_dma1_stream1 = _default_exception_handler);
PROVIDE(_dma1_stream2 = _default_exception_handler);
PROVIDE(_dma1_stream3 = _default_exception_handler);
PROVIDE(_dma1_stream4 = _default_exception_handler);
PROVIDE(_dma1_stream5 = _default_exception_handler);
PROVIDE(_dma1_stream6 = _default_exception_handler);
PROVIDE(_adc = _default_exception_handler);
PROVIDE(_can1_tx = _default_exception_handler);
PROVIDE(_can1_rx0 = _default_exception_handler);
PROVIDE(_can1_rx1 = _default_exception_handler);
PROVIDE(_can1_sce = _default_exception_handler);
PROVIDE(_exti9_5 = _default_exception_handler);
PROVIDE(_tim1_brk_tim9 = _default_exception_handler);
PROVIDE(_tim1_up_tim10 = _default_exception_handler);
PROVIDE(_tim1_trg_com_tim11 = _default_exception_handler);
PROVIDE(_tim1_cc = _default_exception_handler);
PROVIDE(_tim2 = _default_exception_handler);
PROVIDE(_tim3 = _default_exception_handler);
PROVIDE(_tim4 = _default_exception_handler);
PROVIDE(_i2c1_ev = _default_exception_handler);
PROVIDE(_i2c1_er = _default_exception_handler);
PROVIDE(_i2c2_ev = _default_exception_handler);
PROVIDE(_i2c2_er = _default_exception_handler);
PROVIDE(_spi1 = _default_exception_handler);
PROVIDE(_spi2 = _default_exception_handler);
PROVIDE(_usart1 = _default_exception_handler);
PROVIDE(_usart2 = _default_exception_handler);
PROVIDE(_usart3 = _default_exception_handler);
PROVIDE(_exti15_10 = _default_exception_handler);
PROVIDE(_rtc_alarm = _default_exception_handler);
PROVIDE(_otg_fs_wkup = _default_exception_handler);
PROVIDE(_tim8_brk_tim12 = _default_exception_handler);
PROVIDE(_tim8_up_tim13 = _default_exception_handler);
PROVIDE(_tim8_trg_com_tim14 = _default_exception_handler);
PROVIDE(_tim8_cc = _default_exception_handler);
PROVIDE(_dma1_stream7 = _default_exception_handler);
PROVIDE(_fsmc = _default_exception_handler);
PROVIDE(_sdio = _default_exception_handler);
PROVIDE(_tim5 = _default_exception_handler);
PROVIDE(_spi3 = _default_exception_handler);
PROVIDE(_uart4 = _default_exception_handler);
PROVIDE(_uart5 = _default_exception_handler);
PROVIDE(_tim6_dac = _default_exception_handler);
PROVIDE(_tim7 = _default_exception_handler);
PROVIDE(_dma2_stream0 = _default_exception_handler);
PROVIDE(_dma2_stream1 = _default_exception_handler);
PROVIDE(_dma2_stream2 = _default_exception_handler);
PROVIDE(_dma2_stream3 = _default_exception_handler);
PROVIDE(_dma2_stream4 = _default_exception_handler);
PROVIDE(_eth = _default_exception_handler);
PROVIDE(_eth_wkup = _default_exception_handler);
PROVIDE(_can2_tx = _default_exception_handler);
PROVIDE(_can2_rx0 = _default_exception_handler);
PROVIDE(_can2_rx1 = _default_exception_handler);
PROVIDE(_can2_sce = _default_exception_handler);
PROVIDE(_otg_fs = _default_exception_handler);
PROVIDE(_dma2_stream5 = _default_exception_handler);
PROVIDE(_dma2_stream6 = _default_exception_handler);
PROVIDE(_dma2_stream7 = _default_exception_handler);
PROVIDE(_usart6 = _default_exception_handler);
PROVIDE(_i2c3_ev = _default_exception_handler);
PROVIDE(_i2c3_er = _default_exception_handler);
PROVIDE(_otg_hs_ep1_out = _default_exception_handler);
PROVIDE(_otg_hs_ep1_in = _default_exception_handler);
PROVIDE(_otg_hs_wkup = _default_exception_handler);
PROVIDE(_otg_hs = _default_exception_handler);
PROVIDE(_dcmi = _default_exception_handler);
PROVIDE(_cryp = _default_exception_handler);
PROVIDE(_hash_rng = _default_exception_handler);
PROVIDE(_fpu = _default_exception_handler);

ASSERT(_einterrupts - ORIGIN(PROGRAM) == 0x188, "interrupts not linked where expected");
